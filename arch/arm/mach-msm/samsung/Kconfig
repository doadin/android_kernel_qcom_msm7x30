## arch/arm/mach-msm/samsung/Kconfig
```kconfig
config MACH_ARIESVE || MACH_ANCORA  || MACH_GODART || MACH_ANCORA_TMO || MACH_APACHE
	bool

menu "Samsung Board Selection"
source "arch/arm/mach-msm/samsung/Kconfig.board"
endmenu
```

## arch/arm/mach-msm/samsung/Kconfig.board
```kconfig
config MACH_ARIESVE
	depends on ARCH_MSM7X30
	depends on !MSM_STACKED_MEMORY
	select APPSBOOT_3M_CONFIG
	default n
	bool "ARIESVE"
	help
	  Support for the Samsung Aries VE board.

config MACH_ANCORA
	depends on ARCH_MSM7X30
	depends on !MSM_STACKED_MEMORY
	select APPSBOOT_3M_CONFIG
	default n
	bool "ANCORA"
	help
	  Support for the Samsung Ancora board.

config MACH_ANCORA_TMO
       depends on ARCH_MSM7X30
       depends on !MSM_STACKED_MEMORY
       select APPSBOOT_3M_CONFIG
       default n
       bool "ANCORA_TMO"
       help
         Support for the Samsung Ancora TMO board.


config BOARD_REVISION
	hex "Select H/W Revision"
	depends on MACH_ARIESVE || MACH_ANCORA  || MACH_GODART || MACH_ANCORA_TMO || MACH_APACHE
	default "0x00"
```
